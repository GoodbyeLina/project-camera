## sdkconfig.defaults
```kconfig
# Flash size settings
CONFIG_ESPTOOLPY_FLASHSIZE_16MB=y

# PSRAM settings
CONFIG_ESP32S3_SPIRAM_SUPPORT=y
CONFIG_SPIRAM=y
CONFIG_SPIRAM_MODE_QUAD=y
CONFIG_SPIRAM_SIZE=8388608
```
